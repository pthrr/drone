## components/software/companion/meta-companion/conf/layer.conf
```bitbake
BBPATH .= ":${LAYERDIR}"
BBFILES += "${LAYERDIR}/recipes-*/*/*.bb ${LAYERDIR}/recipes-*/*/*.bbappend"
BBFILE_COLLECTIONS += "meta-companion"
BBFILE_PATTERN_meta-companion = "^${LAYERDIR}/"
BBFILE_PRIORITY_meta-companion = "20"
LAYERSERIES_COMPAT_meta-companion = "scarthgap"
```
